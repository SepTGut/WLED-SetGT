#pragma once

#include "wled.h"
#include <Wire.h>
#include <SPI.h>

// AI: below section was generated by an AI
/*
 * Device & Bus Manager Usermod for WLED
 * Provides centralized I2C (Wire) and SPI bus allocation, pin reservation via pinManager,
 * thread-safe mutex locking for multi-usermod transactions, and automatic I2C address scanning.
 */

class UsermodDeviceManager : public Usermod {
private:
  bool enabled = true;
  bool initDone = false;

  // Detected I2C Devices
  uint8_t i2cDevices[16];
  uint8_t i2cDeviceCount = 0;
  bool scanCompleted = false;

  // MutexHandles for ESP32
#ifdef ARDUINO_ARCH_ESP32
  SemaphoreHandle_t i2cMutex = nullptr;
  SemaphoreHandle_t spiMutex = nullptr;
#endif

  static const char _name[];

public:
  UsermodDeviceManager() = default;

  ~UsermodDeviceManager() override {
#ifdef ARDUINO_ARCH_ESP32
    if (i2cMutex) { vSemaphoreDelete(i2cMutex); i2cMutex = nullptr; }
    if (spiMutex) { vSemaphoreDelete(spiMutex); spiMutex = nullptr; }
#endif
  }

  // Acquire I2C Bus Mutex
  bool lockI2C(uint32_t timeoutMs = 100) {
#ifdef ARDUINO_ARCH_ESP32
    if (i2cMutex) {
      return (xSemaphoreTake(i2cMutex, pdMS_TO_TICKS(timeoutMs)) == pdTRUE);
    }
#endif
    return true;
  }

  // Release I2C Bus Mutex
  void unlockI2C() {
#ifdef ARDUINO_ARCH_ESP32
    if (i2cMutex) {
      xSemaphoreGive(i2cMutex);
    }
#endif
  }

  // Acquire SPI Bus Mutex
  bool lockSPI(uint32_t timeoutMs = 100) {
#ifdef ARDUINO_ARCH_ESP32
    if (spiMutex) {
      return (xSemaphoreTake(spiMutex, pdMS_TO_TICKS(timeoutMs)) == pdTRUE);
    }
#endif
    return true;
  }

  // Release SPI Bus Mutex
  void unlockSPI() {
#ifdef ARDUINO_ARCH_ESP32
    if (spiMutex) {
      xSemaphoreGive(spiMutex);
    }
#endif
  }

  // Scan I2C bus for active device addresses (0x08 to 0x77)
  uint8_t scanI2CBus() {
    if (i2c_sda < 0 || i2c_scl < 0) {
      DEBUG_PRINTLN(F("DeviceManager: I2C pins not configured in WLED settings."));
      return 0;
    }

    i2cDeviceCount = 0;
    if (!lockI2C(200)) return 0;

    DEBUG_PRINTLN(F("DeviceManager: Starting I2C bus scan..."));
    for (uint8_t addr = 0x08; addr <= 0x77; addr++) {
      Wire.beginTransmission(addr);
      uint8_t error = Wire.endTransmission();
      if (error == 0) {
        if (i2cDeviceCount < 16) {
          i2cDevices[i2cDeviceCount++] = addr;
        }
        DEBUG_PRINTF("DeviceManager: Found I2C device at 0x%02X\n", addr);
      }
    }

    unlockI2C();
    scanCompleted = true;
    return i2cDeviceCount;
  }

  void setup() override {
#ifdef ARDUINO_ARCH_ESP32
    if (!i2cMutex) i2cMutex = xSemaphoreCreateMutex();
    if (!spiMutex) spiMutex = xSemaphoreCreateMutex();
#endif

    if (!enabled) return;

    // Scan I2C bus only if global I2C is configured
    if (i2c_sda >= 0 && i2c_scl >= 0) {
      scanI2CBus();
    }
    initDone = true;
  }

  void loop() override {
    // Standing manager usermod — no high frequency polling needed
  }

  void addToJsonInfo(JsonObject& root) override {
    if (!enabled) return;

    JsonObject user = root["u"];
    if (user.isNull()) user = root.createNestedObject("u");

    JsonArray devArr = user.createNestedArray(F("I2C Devices"));
    if (i2c_sda < 0 || i2c_scl < 0) {
      devArr.add(F("I2C not configured"));
    } else if (!scanCompleted || i2cDeviceCount == 0) {
      devArr.add(F("None detected"));
    } else {
      for (uint8_t i = 0; i < i2cDeviceCount; i++) {
        char addrStr[8];
        snprintf(addrStr, sizeof(addrStr), "0x%02X", i2cDevices[i]);
        devArr.add(addrStr);
      }
    }
  }

  void addToConfig(JsonObject& root) override {
    JsonObject top = root.createNestedObject(FPSTR(_name));
    top["enabled"] = enabled;
  }

  bool readFromConfig(JsonObject& root) override {
    JsonObject top = root[FPSTR(_name)];
    if (top.isNull()) return false;

    enabled = top["enabled"] | enabled;
    return true;
  }

  uint16_t getId() override {
    return USERMOD_ID_DEVICE_MANAGER;
  }
};
// AI: end
